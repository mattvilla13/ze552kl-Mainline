// SPDX-License-Identifier: GPL-2.0-only

/dts-v1/;

/include/ "msm8953.dtsi"

/ {
	// This is used by the bootloader to find the correct DTB 
	qcom,msm-id = <293 0x0>;
	qcom,board-id= <0x08 0>;

	model = "Qualcomm Technologies, Inc. MSM8953 + PMI8950 MTP";
	compatible = "qcom,msm8953-mtp", "qcom,msm8953", "lk2nd,device";
	lk2nd,pstore = <0x92900000 0x100000>;

};
